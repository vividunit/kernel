//This devicetree overlay is used to test SPI2 by using SPI Flash device.
//Test device: GD25Q127CSIG
/dts-v1/;
/plugin/;

/ {
	fragment@0 {
		target = <&spi2>;

		__overlay__ {
			status = "okay";
			max-freq = <10000000>;
			#address-cells = <1>;
			#size-cells = <0>;

			spiflash: spi-flash@0 {
				#address-cells = <0x1>;
				#size-cells = <1>; 
				compatible = "jedec,spi-nor";
				reg = <0x0>;
				spi-max-frequency = <10000000>;
				status = "okay";

				partitions {
					compatible = "fixed-partitions";
					#address-cells = <1>;
					#size-cells = <1>;

					loader@0 {
						label = "spi2flash";
						reg = <0x0 0x400000>;
					};
				};
			};
		};
	};
};
